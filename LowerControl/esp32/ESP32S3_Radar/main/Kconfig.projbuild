## LowerControl/esp32/ESP32S3_Radar/main/Kconfig.projbuild
```kconfig
menu "ESP-Radar"

    orsource "$IDF_PATH/examples/common_components/env_caps/$IDF_TARGET/Kconfig.env_caps"

    menu "Radar UART Configuration"

        menuconfig RADAR_USING_UART0
            bool "Enable UART0"
            default y
            if RADAR_USING_UART0
                
                config RADAR_UART0_PORT_NUM
                    int "UART0 port number"
                    depends on RADAR_USING_UART0
                    range 0 2 if IDF_TARGET_ESP32 || IDF_TARGET_ESP32S3
                    default 0 if IDF_TARGET_ESP32 || IDF_TARGET_ESP32S3
                    range 0 1 if IDF_TARGET_ESP32S2 || IDF_TARGET_ESP32C3 || IDF_TARGET_ESP32C2 || IDF_TARGET_ESP32H2
                    default 0 if IDF_TARGET_ESP32S2 || IDF_TARGET_ESP32C3 || IDF_TARGET_ESP32C2 || IDF_TARGET_ESP32H2
                    help
                        UART0 communication port number for the example.
                        See UART0 documentation for available port numbers.

                config RADAR_UART0_BAUD_RATE
                    int "UART0 communication speed"
                    range 1200 115200
                    depends on RADAR_USING_UART1
                    default 115200
                    help
                        UART0 communication speed.
                
                config RADAR_UART0_RXD
                    int "UART0 RXD pin number"
                    range ENV_GPIO_RANGE_MIN ENV_GPIO_IN_RANGE_MAX
                    depends on RADAR_USING_UART0
                    default 45
                    help
                        GPIO number for UART0 RX pin.
            
                config RADAR_UART0_TXD
                    int "UART0 TXD pin number"
                    range ENV_GPIO_RANGE_MIN ENV_GPIO_OUT_RANGE_MAX
                    depends on RADAR_USING_UART0
                    default 46
                    help
                        GPIO number for UART0 TX pin. 
            
                config RADAR_UART0_TASK_STACK_SIZE
                    int "UART0 echo example task stack size"
                    range 1024 16384
                    depends on RADAR_USING_UART0
                    default 2048
                    help
                        Defines stack size for UART0
                        Insufficient stack size can cause crash
            endif
            
        menuconfig RADAR_USING_UART1
            bool "Enable UART1"
            default y
            if RADAR_USING_UART1

                config RADAR_UART1_PORT_NUM
                    int "UART1 port number"
                    depends on RADAR_USING_UART1
                    range 0 2 if IDF_TARGET_ESP32 || IDF_TARGET_ESP32S3
                    default 1 if IDF_TARGET_ESP32 || IDF_TARGET_ESP32S3
                    range 0 1 if IDF_TARGET_ESP32S2 || IDF_TARGET_ESP32C3 || IDF_TARGET_ESP32C2 || IDF_TARGET_ESP32H2
                    default 1 if IDF_TARGET_ESP32S2 || IDF_TARGET_ESP32C3 || IDF_TARGET_ESP32C2 || IDF_TARGET_ESP32H2
                    help
                        UART1 communication port number for the example.
                        See UART1 documentation for available port numbers.

                config RADAR_UART1_BAUD_RATE
                    int "UART1 communication speed"
                    range 1200 115200
                    depends on RADAR_USING_UART1
                    default 115200
                    help
                        UART1 communication speed.
                    
                config RADAR_UART1_RXD
                    int "UART1 RXD pin number"
                    range ENV_GPIO_RANGE_MIN ENV_GPIO_IN_RANGE_MAX
                    depends on RADAR_USING_UART1
                    default 41
                    help
                        GPIO number for UART1 RX pin.
                    
                config RADAR_UART1_TXD
                    int "UART1 TXD pin number"
                    range ENV_GPIO_RANGE_MIN ENV_GPIO_OUT_RANGE_MAX
                    depends on RADAR_USING_UART1
                    default 42
                    help
                        GPIO number for UART1 TX pin. 
                    
                config RADAR_UART1_TASK_STACK_SIZE
                    int "UART1 echo example task stack size"
                    range 1024 16384
                    depends on RADAR_USING_UART1
                    default 2048
                    help
                        Defines stack size for UART1
                        Insufficient stack size can cause crash
            endif
            
            if IDF_TARGET_ESP32 || IDF_TARGET_ESP32S3
                menuconfig RADAR_USING_UART2
                    bool "Enable UART2"
                    default y
                    if RADAR_USING_UART2

                        config RADAR_UART2_PORT_NUM
                            int "UART2 port number"
                            depends on RADAR_USING_UART2
                            range 0 2 if IDF_TARGET_ESP32 || IDF_TARGET_ESP32S3
                            default 2 if IDF_TARGET_ESP32 || IDF_TARGET_ESP32S3
                            range 0 1 if IDF_TARGET_ESP32S2 || IDF_TARGET_ESP32C3 || IDF_TARGET_ESP32C2 || IDF_TARGET_ESP32H2
                            default 1 if IDF_TARGET_ESP32S2 || IDF_TARGET_ESP32C3 || IDF_TARGET_ESP32C2 || IDF_TARGET_ESP32H2
                            help
                                UART2 communication port number for the example.
                                See UART2 documentation for available port numbers.
                            
                        config RADAR_UART2_BAUD_RATE
                            int "UART2 communication speed"
                            range 1200 115200
                            depends on RADAR_USING_UART2
                            default 115200
                            help
                                UART2 communication speed.
                            
                        config RADAR_UART2_RXD
                            int "UART2 RXD pin number"
                            range ENV_GPIO_RANGE_MIN ENV_GPIO_IN_RANGE_MAX
                            depends on RADAR_USING_UART2
                            default 15
                            help
                                GPIO number for UART2 RX pin.
                            
                        config RADAR_UART2_TXD
                            int "UART2 TXD pin number"
                            range ENV_GPIO_RANGE_MIN ENV_GPIO_OUT_RANGE_MAX
                            depends on RADAR_USING_UART2
                            default 16
                            help
                                GPIO number for UART2 TX pin. 
                            
                        config RADAR_UART2_TASK_STACK_SIZE
                            int "UART2 echo example task stack size"
                            range 1024 16384
                            depends on RADAR_USING_UART2
                            default 2048
                            help
                                Defines stack size for UART2
                                Insufficient stack size can cause crash
                    endif
            endif
    endmenu
endmenu
```
